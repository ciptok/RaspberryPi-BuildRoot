## package/libtirpc/Config.in
```kconfig
config BR2_PACKAGE_LIBTIRPC
	bool "libtirpc"
	depends on !BR2_TOOLCHAIN_HAS_NATIVE_RPC
	help
	  Libtirpc is a port of Suns Transport-Independent RPC library
	  to Linux.

	  http://sourceforge.net/projects/libtirpc/

config BR2_RPC_SUPPORT_AVAILABLE
       bool
       default y if (BR2_TOOLCHAIN_HAS_NATIVE_RPC || BR2_PACKAGE_LIBTIRPC)
```

## package/libxkbcommon/Config.in
```kconfig
config BR2_PACKAGE_LIBXKBCOMMON
	bool "libxkbcommon"
        depends on BR2_PACKAGE_XPROTO_XPROTO
	help
            libxkbcommon
```

## package/quota/Config.in
```kconfig
config BR2_PACKAGE_QUOTA
	bool "quota"
	depends on BR2_RPC_SUPPORT_AVAILABLE
	depends on BR2_LARGEFILE
	depends on BR2_USE_WCHAR
	select BR2_PACKAGE_UTIL_LINUX
	select BR2_PACKAGE_UTIL_LINUX_MOUNT
	select BR2_PACKAGE_GETTEXT if BR2_NEEDS_GETTEXT_IF_LOCALE
	select BR2_PACKAGE_LIBINTL if BR2_NEEDS_GETTEXT_IF_LOCALE
	help
	  Implementation of the disk quota system.

	  http://sourceforge.net/projects/linuxquota/

comment "quota requires a toolchain with LARGEFILE + WCHAR support, and RPC (toolchain or libtirpc)"
	depends on !(BR2_RPC_SUPPORT_AVAILABLE && BR2_LARGEFILE && BR2_USE_WCHAR)
```

## package/rpcbind/Config.in
```kconfig
config BR2_PACKAGE_RPCBIND
	bool "rpcbind"
	select BR2_PACKAGE_LIBTIRPC
	help
	  The rpcbind utility is a server that converts RPC program numbers
	  into universal addresses.
```
